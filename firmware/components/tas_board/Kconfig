## firmware/components/tas_board/Kconfig
```kconfig
menu "tinyaisense"

    choice TAS_BOARD
        prompt "Board"
        default TAS_BOARD_M5STACK_ATOM_ECHO
        help
            The hardware this firmware is built for. Each Board gets its own binary.

        config TAS_BOARD_M5STACK_ATOM_ECHO
            bool "M5Stack Atom Echo"
    endchoice

endmenu
```

## firmware/components/tas_kinds/Kconfig
```kconfig
menu "tinyaisense Kinds"

    config TAS_SPEAKER_VOLUME
        int "Speaker volume at boot"
        range 0 100
        default 80
        help
            Each speaker's volume until the hub sets one with set_volume, on its log curve: 0
            mutes, 1 is -40 dB and 100 is 0 dB. The device never stores the hub's volume. Keep
            it the same as the Simulator's default_volume.

    config TAS_SPEAKERS_MAX
        int "Speakers a Board may have"
        range 1 4
        default 1
        help
            Each speaker's playout holds about 8 KB of static buffers.

    config TAS_TEST_HOOKS
        bool "Test hooks"
        default n
        help
            Debug builds only: console commands that drive the Kinds for tests by hand and in
            the loop, e.g. a test tone and its cut, with the firmware's own timing of them.

endmenu
```

## firmware/spike-loopback/sdkconfig.defaults
```kconfig
CONFIG_ESPTOOLPY_FLASHSIZE_4MB=y
CONFIG_FREERTOS_HZ=1000
CONFIG_ESP_MAIN_TASK_STACK_SIZE=6144
CONFIG_BT_ENABLED=n
```

## firmware/spike-respeaker/sdkconfig.defaults
```kconfig
# PROTOTYPE: XIAO ESP32S3 (8 MB flash, 8 MB octal PSRAM), console on the USB-Serial/JTAG.
CONFIG_ESPTOOLPY_FLASHSIZE_8MB=y
CONFIG_PARTITION_TABLE_SINGLE_APP_LARGE=y
CONFIG_SPIRAM=y
CONFIG_SPIRAM_MODE_OCT=y
CONFIG_SPIRAM_SPEED_80M=y
CONFIG_ESP_CONSOLE_USB_SERIAL_JTAG=y
CONFIG_ESP_CONSOLE_SECONDARY_NONE=y
CONFIG_ESP_DEFAULT_CPU_FREQ_MHZ_240=y
CONFIG_FREERTOS_HZ=1000
CONFIG_FREERTOS_GENERATE_RUN_TIME_STATS=y
CONFIG_FREERTOS_USE_TRACE_FACILITY=y
CONFIG_FREERTOS_USE_STATS_FORMATTING_FUNCTIONS=y
CONFIG_FREERTOS_VTASKLIST_INCLUDE_COREID=y
CONFIG_FREERTOS_RUN_TIME_COUNTER_TYPE_U64=y
CONFIG_BT_ENABLED=n
CONFIG_ESP_WIFI_TASK_PINNED_TO_CORE_0=y
CONFIG_LWIP_TCPIP_TASK_AFFINITY_CPU0=y
CONFIG_LWIP_UDP_RECVMBOX_SIZE=16
CONFIG_ESP_TASK_WDT_TIMEOUT_S=10
CONFIG_ESP_MAIN_TASK_STACK_SIZE=8192
```
